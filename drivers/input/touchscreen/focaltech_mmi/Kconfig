## drivers/input/touchscreen/focaltech_mmi/Kconfig
```kconfig
#
# Focaltech touchscreen driver configuration
#
config TOUCHSCREEN_FOCALTECH_MMI
	tristate "Focaltech touchscreen in MMI revision"
	help
	  Say Y here if you have a Focaltech touchscreen connected
	  to your system.
	  This revision supports MMI features.

	  If unsure, say N.
```

## drivers/input/touchscreen/ilitek_mmi/Kconfig
```kconfig
#
# Ipio Touchscreen driver configuration
#

config TOUCHSCREEN_ILI9881H
    tristate "Ipio ILI9881H Touchscreen"
    depends on I2C && TOUCHSCREEN_ILITEK_CHIPSET
    default n
    help
    Say Y here if you have Ilitek touch panel.
    If unsure, say N.
```

## drivers/input/touchscreen/nova_36525_mmi/Kconfig
```kconfig
#
# Novatek NT36525 touchscreen driver configuration
#
config TOUCHSCREEN_NT36525
	tristate "Novatek NT36525"
	depends on TOUCHSCREEN_NOVATEK_NT36525_CHIPSET
	help
	  Say Y here if you have a Novatek NT36525 touchscreen connected
	  to your system.
```

## drivers/input/touchscreen/nova_mmi/Kconfig
```kconfig
#
# Novatek NT36xxx touchscreen driver configuration
#
config TOUCHSCREEN_NT36xxx
	tristate "Novatek NT36xxx"
	depends on TOUCHSCREEN_NOVATEK_NT36xxx_CHIPSET
	help
	  Say Y here if you have a Novatek NT36xxx touchscreen connected
	  to your system.
```

## drivers/misc/awinic/aw869x/Kconfig
```kconfig
#
# AW869X Driver
#

config AW869X_HAPTIC
	tristate "Awinic AW869X haptic driver"
	depends on I2C && INPUT_AWINIC_HAPTIC
	help
	  Say Y here if you have Awinic AW869X haptic controller
	  chip in your system.

	  If unsure, say N.

	  To compile this driver as a module, choose M here: the
	  module will be called aw869x.
```

## drivers/nfc/st21nfc/Kconfig
```kconfig
config NFC_ST21NFC
	tristate "ST Microelectronics ST21NFC NFC Controller Driver"
	depends on I2C
	---help---
	  ST Microelectronics ST21NFC Near Field Communication controller support
```
